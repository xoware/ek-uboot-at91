/dts-v1/;


/ {
	model = "Exokey Boot";
	compatible = "arm";
        
	signature {

		key-kernel_key {
			rsa,r-squared = <0xa50205bb 0xe90f3f29 0xf829a24d 0x4dda571f 0x3e955fb1 0xcb8d4439 0x49f24e60 0xdfb03e24 0xfaacce1 0x7464e0f0 0x2f99e7c2 0x89bed96c 0x6d8bc1db 0x1e4b73b 0x7dd30678 0xad27b18c 0xf0368060 0xb9610750 0xfb719197 0x97c63df4 0x170c96d4 0x36b8a76 0x17dc4a9f 0x6924d173 0x1fcd37f0 0x63881d92 0x6602b06e 0x442fea3b 0xed78233f 0xf016b1f7 0x3634dff3 0x155ee9ce 0xf80fb525 0x530b0d36 0xff86947d 0x2383e617 0xd581d1c9 0x8fe86991 0xbfe531ee 0xbea77dca 0xe565de92 0x63ee10d1 0x922dcac0 0x1d70afa9 0x75cdbbdc 0x9f9bea71 0x85de3941 0x1ebe8ddb 0xed3c4486 0xfd3466fe 0x86c5dd90 0x298a37c1 0x4c3c362b 0x97ef3a41 0xce24c8c3 0x88c7d955 0x5d3ff3eb 0xc75901b6 0xb9ed5cc0 0x66119c35 0x3b5629f1 0x776ef931 0xce5deed9 0xa55f56e1>;
			rsa,modulus = <0xad8ccf9f 0xc4920cae 0x465cb391 0x603c4958 0xced45f 0x2353d74 0x46d79430 0x7119798d 0xbd7b99c2 0x6dd1723 0xa613b77e 0x4ebec49b 0x846c63ec 0xe545a697 0xa3b195f1 0xefb6eb8f 0x1b82d48b 0xc108b15d 0xb0b6be99 0xe7e47998 0x55785cc2 0x4ec6510 0x78d23aa 0xe966807b 0x4a6cb8e8 0x50b64570 0xe3192d48 0x3bc99a72 0x520ddd8f 0x3f661f9f 0x799c2ec9 0x26aa6705 0x9fb9d59b 0xe51681e3 0x15e8801b 0x38cc57ac 0x608c1cf 0xa4a7ca15 0x57302c8f 0x65b45755 0xa906874a 0xa165a141 0x5899152d 0x17594c6 0x13b28f91 0x3d4b3160 0xe4f9e685 0x612a6b01 0x5f30216c 0xb0c097d9 0xafa6acbf 0xc4f8409a 0x706fdf99 0x1f2de94d 0xfc7e04ae 0x631cc440 0xbe1b0768 0xc4a0eb3 0x8847cd2c 0x2cfb64f1 0x29808ada 0xa0f740ee 0x5363c025 0xd760ffed>;
			rsa,n0-inverse = <0x97a4ca1b>;
			rsa,num-bits = <0x800>;
			required = "conf";
			algo = "sha1,rsa2048";
			key-name-hint = "kernel_key";
		};
	};
};

